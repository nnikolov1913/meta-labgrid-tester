## conf/layer.conf
```bitbake
# We have a conf and classes directory, add to BBPATH
BBPATH .= ":${LAYERDIR}"

# We have recipes-* directories, add to BBFILES
BBFILES += "${LAYERDIR}/recipes-*/*/*.bb \
            ${LAYERDIR}/recipes-*/*/*.bbappend"

BBFILE_COLLECTIONS += "meta-labgrid-tester"
BBFILE_PATTERN_meta-labgrid-tester = "^${LAYERDIR}/"
BBFILE_PRIORITY_meta-labgrid-tester = "66"

LAYERDEPENDS_meta-labgrid-tester = "core"
LAYERSERIES_COMPAT_meta-labgrid-tester = "scarthgap"
```
